## agent/ai/Kconfig
```kconfig
# SPDX-License-Identifier: GPL-2.0
#
# AIKernel - AI Subsystem Kconfig
#
# 本文件定义 AI 子系统的内核配置选项。
# 由 agent/Kconfig 引入，在 AI_AGENT 菜单内。

menu "AI Kernel Subsystem"

config AIKERNEL_AGENT
	bool "AI Kernel Subsystem (Agent)"
	depends on AI_AGENT
	default n
	help
	  Enable the AI Kernel Subsystem.
	  This provides an AI Runtime and AI Shell for kernel-integrated
	  AI inference capabilities.

	  This is a user-space tool built alongside the kernel.
	  It does not modify core kernel functionality (Scheduler,
	  Memory, VFS) in phase 1.

	  NOTE: renamed from AIKERNEL to AIKERNEL_AGENT (Prompt 01) to make
	  room for the AIKernel total switch CONFIG_AIKERNEL (AIKernel/Kconfig).

	  If unsure, say N.

config AIKERNEL_CORE
	bool "AI Kernel Core Module"
	depends on AIKERNEL_AGENT
	default y
	help
	  Build the AI kernel core module (agent/ai/core/).
	  Provides kernel-side AI infrastructure: registration,
	  request handling, and event dispatch.

config AIKERNEL_SHELL
	bool "AI Shell"
	depends on AIKERNEL_AGENT
	default y
	help
	  Build the AI Shell interactive CLI tool.
	  The AI Shell provides an interactive command-line interface
	  similar to git or docker for AI operations.

config AIKERNEL_CLOUD_PROVIDER
	bool "Cloud AI Provider (OpenAI Compatible)"
	depends on AIKERNEL_AGENT
	default y
	help
	  Enable the OpenAI-compatible Cloud AI Provider.
	  Supports all services using the OpenAI Chat Completions API:
	  DeepSeek, OpenAI, Qwen, Moonshot, OpenRouter, SiliconFlow, etc.
	  Includes true incremental streaming (SSE over chunked HTTP/HTTPS)
	  when AIKERNEL_STREAM_MODE is also enabled.
	  This switch gates the build: agent/ai/Makefile compiles
	  cloud/provider_openai_compatible.c, cloud/http/http_client.c,
	  cloud/tls/tls_manager.c and the cloud backend only when set.

config AIKERNEL_LOCAL_PROVIDER
	bool "Local AI Provider (Ollama / OpenAI-compatible local server)"
	depends on AIKERNEL_AGENT
	default y
	help
	  Enable the Local AI Provider for on-device model inference via
	  an OpenAI-compatible local server (Ollama, llama.cpp server,
	  LM Studio). Covers both protocols: OpenAI /v1 and Ollama native
	  /api/chat (the only channel supporting options.num_ctx).
	  This switch gates the build: agent/ai/Makefile compiles
	  local/provider_local.c, local_chat.c, local_http.c,
	  ollama_native.c and the local backend only when set.
	  The provider registry, status and model management reflect the
	  switch: with it off, no local provider is registered.

config AIKERNEL_STREAM_MODE
	bool "Stream Mode Support (SSE / NDJSON incremental output)"
	depends on AIKERNEL_AGENT
	default y
	help
	  Enable streaming response support. True incremental delivery:
	  each delta.content is flushed to the terminal as it arrives
	  (cloud: SSE over chunked HTTP/HTTPS with incremental chunked
	  decoding; local: SSE / Ollama NDJSON). Falls back to
	  non-streaming requests when the switch is off, and
	  `config set stream on` then reports that streaming is not
	  compiled in instead of silently pretending.
	  This switch gates the build: agent/ai/Makefile compiles
	  local/local_stream.c and runtime/communication/stream_parse.c
	  (and the streaming branches of both backends) only when set.

endmenu
```

## kernel-overlays/samples/ai/Kconfig
```kconfig
# SPDX-License-Identifier: GPL-2.0
#
# samples/ai/Kconfig - AIKernel AI 示例
#
# 全部 default n（示例仅作模板，不进入默认构建）。

config SAMPLE_AI_SCHED_POLICY
	tristate "AIKernel AI scheduler policy sample"
	depends on AIKERNEL && AIKERNEL_RUNTIME && m
	help
	  AI 调度器策略注册示例模块：演示 ai_policy_register() 的
	  "域 + 动作名 + 回调 + 回滚" 接入模板（AI 自动化接入调度决策）。

	  If unsure, say N.

config SAMPLE_AI_IO_SCHEDULER
	tristate "AIKernel AI I/O scheduler sample"
	depends on AIKERNEL && AIKERNEL_RUNTIME && AIKERNEL_IO && m
	help
	  AI I/O 调度器决策接入示例模块：演示 io 域策略注册 +
	  ai_io_dispatch_hook() 咨询点调用姿势。

	  If unsure, say N.

config SAMPLE_AI_BPF_HELPER
	tristate "AIKernel AI BPF helper sample"
	depends on AIKERNEL && AIKERNEL_RUNTIME && AIKERNEL_BPF && m
	help
	  BPF AI helper 示例模块：演示 bpf_ai_query / bpf_ai_telemetry
	  核心函数调用与 AI PMU（ai/inference）发射。

	  If unsure, say N.
```
